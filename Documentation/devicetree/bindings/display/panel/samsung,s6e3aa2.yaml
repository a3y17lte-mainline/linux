## Documentation/devicetree/bindings/display/panel/samsung,s6e3aa2.yaml
```yaml
# SPDX-License-Identifier: (GPL-2.0-only OR BSD-2-Clause)
%YAML 1.2
---
$id: http://devicetree.org/schemas/display/panel/samsung,s6e3aa2.yaml#
$schema: http://devicetree.org/meta-schemas/core.yaml#

title: Samsung AMS474MM01 panel with S6E3AA2 controller

maintainers:
  - Martin Štrobl <recordyletsplays@gmail.com>

description:
  4.7 inch 720x1280 AMOLED panel, driven over MIPI DSI in command mode with
  4 data lanes. Found in the Samsung Galaxy A3 (2017).

allOf:
  - $ref: panel-common.yaml#

properties:
  compatible:
    const: samsung,s6e3aa2-ams474mm01

  reg:
    maxItems: 1

  vdd-supply:
    description: I/O voltage supply (1.8 V)

  vci-supply:
    description: voltage supply for analog circuits (3.0 V)

  reset-gpios: true

required:
  - compatible
  - reg
  - vdd-supply
  - vci-supply
  - reset-gpios

unevaluatedProperties: false

examples:
  - |
    #include <dt-bindings/gpio/gpio.h>

    dsi {
        #address-cells = <1>;
        #size-cells = <0>;

        panel@0 {
            compatible = "samsung,s6e3aa2-ams474mm01";
            reg = <0>;

            vdd-supply = <&panel_vdd_reg>;
            vci-supply = <&panel_vci_reg>;

            reset-gpios = <&gpd3 4 GPIO_ACTIVE_LOW>;
        };
    };

...
```

## Documentation/devicetree/bindings/iio/samsung,sensorhub-rinato.yaml
```yaml
# SPDX-License-Identifier: (GPL-2.0 OR BSD-2-Clause)
%YAML 1.2
---
$id: http://devicetree.org/schemas/iio/samsung,sensorhub-rinato.yaml#
$schema: http://devicetree.org/meta-schemas/core.yaml#

title: Samsung Sensorhub driver

maintainers:
  - Jonathan Cameron <jic23@kernel.org>

description: |
  Sensorhub is a MCU which manages several sensors and also plays the role
  of a virtual sensor device.

properties:
  compatible:
    enum:
      - samsung,sensorhub-a3y17lte
      - samsung,sensorhub-rinato
      - samsung,sensorhub-thermostat

  reg:
    maxItems: 1

  interrupts:
    maxItems: 1

  ap-mcu-gpios:
    maxItems: 1
    description:
      Application Processor to sensorhub line - used during communication

  mcu-ap-gpios:
    maxItems: 1
    description:
      Sensorhub to Application Processor - used during communication

  mcu-reset-gpios:
    maxItems: 1
    description:
      Reset the sensorhub.

  boot0-gpios:
    maxItems: 1
    description:
      Boot mode selection pin of the sensorhub MCU. It is driven low so that
      the MCU starts its application firmware.

  samsung,accel-position:
    $ref: /schemas/types.yaml#/definitions/uint32
    maximum: 7
    description:
      Mounting position of the accelerometer and gyroscope, as an index into
      the axis remapping table of the sensorhub firmware.

  samsung,mag-position:
    $ref: /schemas/types.yaml#/definitions/uint32
    maximum: 7
    description:
      Mounting position of the magnetometer, as an index into the axis
      remapping table of the sensorhub firmware.

  samsung,light-coefficients:
    $ref: /schemas/types.yaml#/definitions/int32-array
    items:
      - description: red coefficient
      - description: green coefficient
      - description: blue coefficient
      - description: clear coefficient
      - description: device and glass factor
      - description: colour temperature coefficient
      - description: colour temperature offset
    description:
      Coefficients the sensorhub firmware uses to compute illuminance and
      colour temperature from the light sensor channels. They depend on the
      cover glass above the sensor.

  samsung,proximity-thresholds:
    $ref: /schemas/types.yaml#/definitions/uint32-array
    items:
      - description: high threshold
      - description: low threshold
      - description: high threshold for detection
      - description: low threshold for detection
    description:
      Proximity sensor thresholds for the sensorhub firmware, in raw
      proximity counts.

required:
  - compatible
  - reg
  - interrupts
  - ap-mcu-gpios
  - mcu-ap-gpios
  - mcu-reset-gpios

allOf:
  - $ref: /schemas/spi/spi-peripheral-props.yaml#
  - if:
      properties:
        compatible:
          not:
            contains:
              const: samsung,sensorhub-a3y17lte
    then:
      properties:
        samsung,accel-position: false
        samsung,mag-position: false
        samsung,light-coefficients: false
        samsung,proximity-thresholds: false

unevaluatedProperties: false

examples:
  - |
    spi {
        #address-cells = <1>;
        #size-cells = <0>;

        sensorhub@0 {
            compatible = "samsung,sensorhub-rinato";
            reg = <0>;
            spi-max-frequency = <5000000>;
            interrupt-parent = <&gpx0>;
            interrupts = <2 0>;
            ap-mcu-gpios = <&gpx0 0 0>;
            mcu-ap-gpios = <&gpx0 4 0>;
            mcu-reset-gpios = <&gpx0 5 0>;
        };
    };
  - |
    #include <dt-bindings/gpio/gpio.h>
    #include <dt-bindings/interrupt-controller/irq.h>

    spi {
        #address-cells = <1>;
        #size-cells = <0>;

        sensorhub@0 {
            compatible = "samsung,sensorhub-a3y17lte";
            reg = <0>;
            spi-max-frequency = <4800000>;
            interrupts-extended = <&gpa0 7 IRQ_TYPE_EDGE_FALLING>;
            ap-mcu-gpios = <&gpd4 2 GPIO_ACTIVE_HIGH>;
            mcu-ap-gpios = <&gpd3 7 GPIO_ACTIVE_HIGH>;
            mcu-reset-gpios = <&gpd2 3 GPIO_ACTIVE_HIGH>;
            boot0-gpios = <&gpd4 3 GPIO_ACTIVE_HIGH>;
            samsung,accel-position = <5>;
            samsung,mag-position = <7>;
            samsung,light-coefficients = <(-830) 1100 (-1180) 1000 925 3521 2095>;
            samsung,proximity-thresholds = <55 40 250 130>;
        };
    };
...
```

## Documentation/devicetree/bindings/leds/richtek,rt8547.yaml
```yaml
# SPDX-License-Identifier: (GPL-2.0-only OR BSD-2-Clause)
%YAML 1.2
---
$id: http://devicetree.org/schemas/leds/richtek,rt8547.yaml#
$schema: http://devicetree.org/meta-schemas/core.yaml#

title: Richtek RT8547 1.6 A flash LED driver

maintainers:
  - Martin Štrobl <recordyletsplays@gmail.com>

description: |
  The RT8547 is a boost flash LED driver for one LED, with separate torch
  (25 mA to 400 mA) and strobe (100 mA to 1.6 A) currents and a strobe
  safety timer. Its registers are written through a one-wire interface on
  the FLSET pin; holding FLSET low for 1.5 ms shuts the chip down. The FLEN
  pin turns the LED on in the mode and at the current set by the registers.

properties:
  compatible:
    const: richtek,rt8547

  flset-gpios:
    maxItems: 1
    description: GPIO connected to the FLSET (one-wire control) pin.

  flen-gpios:
    maxItems: 1
    description: GPIO connected to the FLEN (LED enable) pin.

  vin-supply:
    description: Power supply for the VIN pin (2.8 V to 5.5 V).

  led:
    type: object
    $ref: common.yaml#
    unevaluatedProperties: false

    properties:
      led-max-microamp:
        minimum: 25000
        maximum: 400000
        description: Maximum torch current, set in 25 mA steps.

      flash-max-microamp:
        minimum: 100000
        maximum: 1600000
        description: Maximum strobe current, set in 50 mA steps.

      flash-max-timeout-us:
        minimum: 64000
        maximum: 1216000
        description: Maximum strobe duration, set in 32 ms steps.

    required:
      - led-max-microamp
      - flash-max-microamp
      - flash-max-timeout-us

required:
  - compatible
  - flset-gpios
  - flen-gpios
  - led

additionalProperties: false

examples:
  - |
    #include <dt-bindings/gpio/gpio.h>
    #include <dt-bindings/leds/common.h>

    led-controller {
        compatible = "richtek,rt8547";
        flset-gpios = <&gpd3 3 GPIO_ACTIVE_HIGH>;
        flen-gpios = <&gpd3 2 GPIO_ACTIVE_HIGH>;

        led {
            function = LED_FUNCTION_FLASH;
            color = <LED_COLOR_ID_WHITE>;
            led-max-microamp = <125000>;
            flash-max-microamp = <1200000>;
            flash-max-timeout-us = <1216000>;
        };
    };
...
```

## Documentation/devicetree/bindings/mfd/samsung,s2mu005-pmic.yaml
```yaml
# SPDX-License-Identifier: GPL-2.0-only OR BSD-2-Clause
%YAML 1.2
---
$id: http://devicetree.org/schemas/mfd/samsung,s2mu005-pmic.yaml#
$schema: http://devicetree.org/meta-schemas/core.yaml#

title: Samsung S2MU004/S2MU005 Power Management IC

maintainers:
  - Kaustabh Chakraborty <kauschluss@disroot.org>

description: |
  The S2MU005 is a companion power management IC which includes subdevices for
  a charger controller, an MUIC (Micro USB Interface Controller), and flash and
  RGB LED controllers.

  The S2MU004 is a similar IC for USB Type-C devices. Its charger controller
  is supported; the USB Type-C/PD controller is a separate I2C device.

allOf:
  - $ref: /schemas/power/supply/power-supply.yaml#
  - if:
      properties:
        compatible:
          contains:
            const: samsung,s2mu004-pmic
    then:
      properties:
        flash: false
        multi-led: false
    else:
      properties:
        io-channels: false
        io-channel-names: false
        usb-otg-vbus-regulator: false

properties:
  compatible:
    enum:
      - samsung,s2mu004-pmic
      - samsung,s2mu005-pmic

  flash:
    $ref: /schemas/leds/samsung,s2mu005-flash.yaml#
    description:
      Child node describing flash LEDs.

  interrupts:
    maxItems: 1

  io-channels:
    maxItems: 1
    description:
      Battery temperature, in millidegrees Celsius, for the charging
      temperature limits.

  io-channel-names:
    const: batt-temp

  muic:
    $ref: /schemas/extcon/samsung,s2mu005-muic.yaml#
    description:
      Child node describing MUIC device.

  multi-led:
    type: object

    allOf:
      - $ref: /schemas/leds/leds-class-multicolor.yaml#

    properties:
      compatible:
        const: samsung,s2mu005-rgb

    required:
      - compatible

    unevaluatedProperties: false

  reg:
    maxItems: 1

  usb-otg-vbus-regulator:
    type: object
    $ref: /schemas/regulator/regulator.yaml#
    unevaluatedProperties: false
    description:
      The charger's OTG boost, supplying VBUS to USB devices (S2MU004).

  wakeup-source: true

required:
  - compatible
  - reg

unevaluatedProperties: false

examples:
  - |
    #include <dt-bindings/interrupt-controller/irq.h>
    #include <dt-bindings/leds/common.h>

    i2c {
        #address-cells = <1>;
        #size-cells = <0>;

        pmic@3d {
            compatible = "samsung,s2mu005-pmic";
            reg = <0x3d>;
            interrupt-parent = <&gpa2>;
            interrupts = <7 IRQ_TYPE_LEVEL_LOW>;

            monitored-battery = <&battery>;

            flash {
                compatible = "samsung,s2mu005-flash";
                #address-cells = <1>;
                #size-cells = <0>;

                led@0 {
                    reg = <0>;
                    color = <LED_COLOR_ID_WHITE>;
                    function = LED_FUNCTION_FLASH;
                };

                led@1 {
                    reg = <1>;
                    color = <LED_COLOR_ID_WHITE>;
                    function = LED_FUNCTION_FLASH;
                    function-enumerator = <1>;
                };
            };

            muic {
                compatible = "samsung,s2mu005-muic";

                connector {
                    compatible = "usb-b-connector";
                    label = "micro-USB";
                    type = "micro";
                };

                port {
                    muic_to_usb: endpoint {
                        remote-endpoint = <&usb_to_muic>;
                    };
                };
            };

            multi-led {
                compatible = "samsung,s2mu005-rgb";
                color = <LED_COLOR_ID_RGB>;
                function = LED_FUNCTION_INDICATOR;
                linux,default-trigger = "pattern";
            };
        };
    };
```

## Documentation/devicetree/bindings/usb/samsung,s2mu004-usbpd.yaml
```yaml
# SPDX-License-Identifier: GPL-2.0-only OR BSD-2-Clause
%YAML 1.2
---
$id: http://devicetree.org/schemas/usb/samsung,s2mu004-usbpd.yaml#
$schema: http://devicetree.org/meta-schemas/core.yaml#

title: Samsung S2MU004 USB Type-C/PD controller

maintainers:
  - Martin Štrobl <recordyletsplays@gmail.com>

description:
  The S2MU004 power management IC has a USB Type-C port controller with a
  USB Power Delivery PHY on its own I2C address. It detects the CC lines and
  sends and receives PD messages. VBUS is sensed and sourced by the S2MU004
  charger (samsung,s2mu004-pmic), which supplies VBUS to the port through its
  OTG boost regulator.

properties:
  compatible:
    const: samsung,s2mu004-usbpd

  reg:
    maxItems: 1

  interrupts:
    maxItems: 1

  vbus-supply:
    description: VBUS power supply, the charger's OTG boost.

  connector:
    type: object
    $ref: /schemas/connector/usb-connector.yaml#
    unevaluatedProperties: false

required:
  - compatible
  - reg
  - interrupts
  - vbus-supply
  - connector

additionalProperties: false

examples:
  - |
    #include <dt-bindings/interrupt-controller/irq.h>
    #include <dt-bindings/usb/pd.h>

    i2c {
        #address-cells = <1>;
        #size-cells = <0>;

        typec@3c {
            compatible = "samsung,s2mu004-usbpd";
            reg = <0x3c>;
            interrupt-parent = <&gpa0>;
            interrupts = <5 IRQ_TYPE_LEVEL_LOW>;
            vbus-supply = <&otg_vbus>;

            connector {
                compatible = "usb-c-connector";
                label = "USB-C";
                data-role = "dual";
                power-role = "dual";
                try-power-role = "sink";
                source-pdos = <PDO_FIXED(5000, 500, PDO_FIXED_DUAL_ROLE |
                                         PDO_FIXED_DATA_SWAP |
                                         PDO_FIXED_USB_COMM)>;
                sink-pdos = <PDO_FIXED(5000, 1500, PDO_FIXED_DUAL_ROLE |
                                       PDO_FIXED_DATA_SWAP |
                                       PDO_FIXED_USB_COMM)>;
                op-sink-microwatt = <2500000>;

                port {
                    endpoint {
                        remote-endpoint = <&usb_hs>;
                    };
                };
            };
        };
    };
```
