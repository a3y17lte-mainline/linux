## Documentation/devicetree/bindings/reset/samsung,exynos7870-dispaud-reset.yaml
```yaml
# SPDX-License-Identifier: (GPL-2.0-only OR BSD-2-Clause)
%YAML 1.2
---
$id: http://devicetree.org/schemas/reset/samsung,exynos7870-dispaud-reset.yaml#
$schema: http://devicetree.org/meta-schemas/core.yaml#

title: Samsung Exynos7870 DISPAUD audio block reset controller

maintainers:
  - Martin Štrobl <recordyletsplays@gmail.com>

description: |
  The audio blocks of the Exynos7870 DISPAUD domain have software reset
  bits in one register of the DISPAUD system registers. A bit set to 1
  holds its block in reset. The reset specifier is the bit number:
    0 - audio mixer
    1 - I2S0 (MI2S_AUD)
    2 - I2S1 (MI2S_AMP)
    3 - audio DMA controller (ADMA)

properties:
  compatible:
    const: samsung,exynos7870-dispaud-reset

  reg:
    maxItems: 1

  "#reset-cells":
    const: 1

required:
  - compatible
  - reg
  - "#reset-cells"

additionalProperties: false

examples:
  - |
    reset-controller@148f1000 {
        compatible = "samsung,exynos7870-dispaud-reset";
        reg = <0x148f1000 0x4>;
        #reset-cells = <1>;
    };
```

## Documentation/devicetree/bindings/sound/audio-graph-card2.yaml
```yaml
# SPDX-License-Identifier: (GPL-2.0-only OR BSD-2-Clause)
%YAML 1.2
---
$id: http://devicetree.org/schemas/sound/audio-graph-card2.yaml#
$schema: http://devicetree.org/meta-schemas/core.yaml#

title: Audio Graph Card2

maintainers:
  - Kuninori Morimoto <kuninori.morimoto.gx@renesas.com>

properties:
  compatible:
    enum:
      - audio-graph-card2
  links:
    $ref: /schemas/types.yaml#/definitions/phandle-array
  label:
    maxItems: 1
  routing:
    $ref: audio-graph.yaml#/properties/routing
  aux-devs:
    description: |
      List of phandles pointing to auxiliary devices, such
      as amplifiers, to be added to the sound card.
    $ref: /schemas/types.yaml#/definitions/phandle-array
  multi:
    type: object
    description: Multi-CPU/Codec node
  dpcm:
    type: object
    description: DPCM node
  codec2codec:
    type: object
    description: Codec to Codec node
    properties:
      ports:
        type: object
        properties:
          rate:
            $ref: /schemas/types.yaml#/definitions/uint32
            description: fixed sample rate of the Codec to Codec link
  hp-det-gpios:
    $ref: audio-graph.yaml#/properties/hp-det-gpios
  mic-det-gpios:
    $ref: audio-graph.yaml#/properties/mic-det-gpios
  widgets:
    $ref: audio-graph.yaml#/properties/widgets
  pin-switches:
    description: the widget names for which pin switches must be created.
    $ref: /schemas/types.yaml#/definitions/string-array

required:
  - compatible
  - links

additionalProperties: false

...
```

## Documentation/devicetree/bindings/sound/samsung,cod3026x.yaml
```yaml
# SPDX-License-Identifier: (GPL-2.0-only OR BSD-2-Clause)
%YAML 1.2
---
$id: http://devicetree.org/schemas/sound/samsung,cod3026x.yaml#
$schema: http://devicetree.org/meta-schemas/core.yaml#

title: Samsung COD3026X audio codec

maintainers:
  - Martin Štrobl <recordyletsplays@gmail.com>

description: |
  The COD3026X is the audio codec of Exynos7870 phones, packaged with the
  S2MPU05 PMIC and controlled over I2C. It has a stereo class-G headphone
  output, an earpiece output, a mono class-D speaker output, three
  microphone inputs with two microphone bias supplies, and jack and button
  detection. Its I2S interface is always a clock consumer.

allOf:
  - $ref: dai-common.yaml#

properties:
  compatible:
    const: samsung,cod3026x

  reg:
    maxItems: 1

  interrupts:
    maxItems: 1
    description: jack and button detection interrupt

  clocks:
    items:
      - description: master clock

  clock-names:
    items:
      - const: mclk

  vdd-supply: true

  '#sound-dai-cells':
    const: 0

  samsung,micbias1-microvolt:
    description: voltage of microphone bias 1
    enum: [2600000, 2800000, 3000000]
    default: 3000000

  samsung,micbias2-microvolt:
    description: voltage of microphone bias 2
    enum: [2600000, 2800000, 3000000]
    default: 3000000

  samsung,micbias-ldo-microvolt:
    description: voltage of the regulator feeding both microphone biases
    enum: [2500000, 2800000, 3000000, 3300000]
    default: 3300000

  io-channels:
    maxItems: 1
    description: ADC channel measuring the microphone line of the jack

  io-channel-names:
    const: jack

  samsung,jack-mic-threshold-microvolt:
    description:
      Voltage on the microphone line above which a plugged jack is a headset
      with a microphone.

  samsung,jack-button-release-microvolt:
    description:
      Voltage on the microphone line above which no headset button is
      pressed.

  samsung,jack-button-thresholds-microvolt:
    description:
      Highest voltage on the microphone line for each headset button, in
      the order of the 3.5 mm headset specification (play/pause, voice
      command, volume up, volume down).
    minItems: 4
    maxItems: 4

  port:
    $ref: audio-graph-port.yaml#
    unevaluatedProperties: false

dependencies:
  io-channels:
    - interrupts
    - io-channel-names
    - samsung,jack-mic-threshold-microvolt
    - samsung,jack-button-release-microvolt
    - samsung,jack-button-thresholds-microvolt

required:
  - compatible
  - reg
  - clocks
  - clock-names
  - vdd-supply
  - '#sound-dai-cells'

unevaluatedProperties: false

examples:
  - |
    #include <dt-bindings/interrupt-controller/irq.h>

    i2c {
        #address-cells = <1>;
        #size-cells = <0>;

        audio-codec@4 {
            compatible = "samsung,cod3026x";
            reg = <0x04>;
            interrupt-parent = <&gpa0>;
            interrupts = <4 IRQ_TYPE_LEVEL_LOW>;
            clocks = <&audmixer>;
            clock-names = "mclk";
            vdd-supply = <&vdd_ldo25>;
            #sound-dai-cells = <0>;
            samsung,micbias1-microvolt = <2800000>;
            samsung,micbias2-microvolt = <2800000>;
            samsung,micbias-ldo-microvolt = <3300000>;
            io-channels = <&adc 2>;
            io-channel-names = "jack";
            samsung,jack-mic-threshold-microvolt = <592000>;
            samsung,jack-button-release-microvolt = <483000>;
            samsung,jack-button-thresholds-microvolt = <92000 128000 214000 440000>;
        };
    };
```

## Documentation/devicetree/bindings/sound/samsung,exynos7870-audmixer.yaml
```yaml
# SPDX-License-Identifier: (GPL-2.0-only OR BSD-2-Clause)
%YAML 1.2
---
$id: http://devicetree.org/schemas/sound/samsung,exynos7870-audmixer.yaml#
$schema: http://devicetree.org/meta-schemas/core.yaml#

title: Samsung Exynos7870 audio mixer

maintainers:
  - Martin Štrobl <recordyletsplays@gmail.com>

description: |
  The audio mixer (S1402X) in the DISPAUD block of the Exynos7870 sits
  between the SoC I2S controllers and the external audio codec. It mixes
  and resamples the streams of its inputs (application processor, modem,
  Bluetooth) and drives the I2S bus towards the codec as bus master. It
  also provides the master clock of the codec on the MCLK pin.

allOf:
  - $ref: dai-common.yaml#

properties:
  compatible:
    const: samsung,exynos7870-audmixer

  reg:
    maxItems: 1

  clocks:
    items:
      - description: register bus clock
      - description: mixer system clock

  clock-names:
    items:
      - const: pclk
      - const: sysclk

  resets:
    maxItems: 1

  '#clock-cells':
    const: 0
    description: the codec master clock output (MCLK pin)

  clock-output-names:
    maxItems: 1

  '#sound-dai-cells':
    const: 1
    description: |
      0 = the application processor interface (to the SoC I2S controller),
      1 = the codec interface (the external I2S bus)

  samsung,pmu-syscon:
    $ref: /schemas/types.yaml#/definitions/phandle
    description: PMU system controller, holding the mixer power control bit

  port:
    $ref: audio-graph-port.yaml#
    unevaluatedProperties: false

  ports:
    $ref: /schemas/graph.yaml#/properties/ports

required:
  - compatible
  - reg
  - clocks
  - clock-names
  - resets
  - '#clock-cells'
  - '#sound-dai-cells'
  - samsung,pmu-syscon

unevaluatedProperties: false

examples:
  - |
    #include <dt-bindings/clock/samsung,exynos7870-cmu.h>

    audio-mixer@14880000 {
        compatible = "samsung,exynos7870-audmixer";
        reg = <0x14880000 0x200>;
        clocks = <&cmu_dispaud CLK_GOUT_DISPAUD_APB_AUD>,
                 <&cmu_dispaud CLK_GOUT_DISPAUD_MIXER_AUD_SYSCLK>;
        clock-names = "pclk", "sysclk";
        resets = <&dispaud_reset 0>;
        #clock-cells = <0>;
        #sound-dai-cells = <1>;
        samsung,pmu-syscon = <&pmu_system_controller>;
        pinctrl-0 = <&i2s_pmic_amp_bus>;
        pinctrl-1 = <&i2s_pmic_amp_bus_idle>;
        pinctrl-names = "default", "sleep";
    };
```
